/****************************************/
; Encabezado
.include "M328PDEF.inc"
.equ	TMR0_VALUE	=	6
.equ	TMR1_VALUE	=	0x85EE
.equ	MAX_MODES	=	7
.def	PUNTO		=	R25

.dseg
MULTIPLEXOR		:	.byte 1
DISP_VALUE		:	.byte 1
UN_MIN			:	.byte 1
DEC_MIN			:	.byte 1
UN_HORA			:	.byte 1
DEC_HORA		:	.byte 1
UN_DIA			:	.byte 1
DEC_DIA			:	.byte 1
UN_MES			:	.byte 1
DEC_MES			:	.byte 1
TIEMPO			:	.byte 1
ESTADO			:	.byte 1

MODE			:	.byte 1
CONTAR			:	.byte 1
MULTIPLEXION	:	.byte 1
INCREMENTAR		:	.byte 1
DECREMENTAR		:	.byte 1
UN_MIN_ALARMA	:	.byte 1
DEC_MIN_ALARMA	:	.byte 1
UN_HORA_ALARMA	:	.byte 1
DEC_HORA_ALARMA	:	.byte 1
ALARMA			:	.byte 1

.cseg
.org 0x0000
	JMP START
.org PCI0addr
	JMP PINB_ISR
.org PCI2addr
	JMP PIND_ISR
.org OVF1addr
	JMP TMR1_ISR
.org OVF0addr
	JMP TMR0_ISR

; Configuración de la pila
	LDI     R16, LOW(RAMEND)
	OUT     SPL, R16
	LDI     R16, HIGH(RAMEND)
	OUT     SPH, R16

; Tabla de valores Display 7 segmentos
table7seg:
	.DB 0x3F,0x06,0x5B,0x4F,0x66,0x6D,0x7D,0x07,0x7F,0x6F,0x77,0x7C,0x39,0x5E,0x79,0x71

/****************************************/
; Configuracion MCU
START:
	CLI

	; Puerto B
	; PB0 = D8  modo
	; PB1 = D9  LED hora
	; PB2 = D10 LED fecha
	; PB3 = D11 hora +
	; PB4 = D12 hora -
	; PB5 = D13 buzzer
	LDI		R16, (1<<DDB1)|(1<<DDB2)|(1<<DDB5)
	OUT		DDRB, R16
	LDI		R16, (1<<PB0)|(1<<PB3)|(1<<PB4)
	OUT		PORTB, R16

	; Puerto C
	; PC0=A
	; PC1=B
	; PC2=C
	; PC3=D
	; PC4=E
	; PC5=F
	LDI		R16, (1<<DDC0)|(1<<DDC1)|(1<<DDC2)|(1<<DDC3)|(1<<DDC4)|(1<<DDC5)
	OUT		DDRC, R16
	CLR		R16
	OUT		PORTC, R16

	; Puerto D
	; PD0 = fecha +
	; PD1 = fecha -
	; PD2 = DP
	; PD3 = D1
	; PD4 = D2
	; PD5 = D3
	; PD6 = D4
	; PD7 = G
	LDI		R16, (1<<DDD2)|(1<<DDD3)|(1<<DDD4)|(1<<DDD5)|(1<<DDD6)|(1<<DDD7)
	OUT		DDRD, R16
	LDI		R16, (1<<PD0)|(1<<PD1)
	OUT		PORTD, R16

	; Apagar UART RX/TX
	LDI		R16, 0x00
	STS		UCSR0B, R16

	; Inicializacion de timers
	CALL	INIT_TMR1
	CALL	INIT_TMR0

	; Limpiar registros y cargar variables
	CLR		PUNTO
	LDI		R16, 0b00001110
	STS		MULTIPLEXOR, R16

	LDI		R16, 0x00
	STS		UN_MIN, R16
	STS		DEC_MIN, R16
	STS		UN_HORA, R16
	STS		DEC_HORA, R16
	STS		DEC_DIA, R16
	STS		DEC_MES, R16
	STS		DISP_VALUE, R16

	STS		UN_MIN_ALARMA, R16
	STS		DEC_MIN_ALARMA, R16
	STS		UN_HORA_ALARMA, R16
	STS		DEC_HORA_ALARMA, R16

	STS		CONTAR, R16
	STS		MODE, R16
	STS		MULTIPLEXION, R16
	STS		INCREMENTAR, R16
	STS		DECREMENTAR, R16
	STS		ALARMA, R16
	STS		TIEMPO, R16

	LDI		R16, 0x01
	STS		UN_DIA, R16
	STS		UN_MES, R16

	IN		R16, PINB
	ANDI	R16, 0b00011001
	STS		ESTADO, R16

	CLR		R16
	CLR		R17

	; Habilitar interrupciones
	; Timer 1
	LDI		R16, (1<<TOIE1)
	STS		TIMSK1, R16
	; Timer 0
	LDI		R16, (1<<TOIE0)
	STS		TIMSK0, R16

	; PCINT en PORTB: PB0 modo, PB3 hora+, PB4 hora-
	; PCINT en PORTD: PD0 fecha+, PD1 fecha-
	LDI		R16, (1<<PCIE0)|(1<<PCIE2)
	STS		PCICR, R16

	LDI		R16, (1<<PCINT0)|(1<<PCINT3)|(1<<PCINT4)
	STS		PCMSK0, R16

	LDI		R16, (1<<PCINT16)|(1<<PCINT17)
	STS		PCMSK2, R16

	CLR		R16
	SEI

/****************************************/
; Loop Infinito
MAIN_LOOP:
VERIFY_MODE0:
	LDS		R16, MODE
	CPI		R16, 0x00
	BRNE	VERIFY_MODE1
	RJMP	MODE_0
VERIFY_MODE1:
	CPI		R16, 0x01
	BRNE	VERIFY_MODE2
	RJMP	MODE_1
VERIFY_MODE2:
	CPI		R16, 0x02
	BRNE	VERIFY_MODE3
	RJMP	MODE_2
VERIFY_MODE3:
	CPI		R16, 0x03
	BRNE	VERIFY_MODE4
	RJMP	MODE_3
VERIFY_MODE4:
	CPI		R16, 0x04
	BRNE	VERIFY_MODE5
	RJMP	MODE_4
VERIFY_MODE5:
	CPI		R16, 0x05
	BRNE	VERIFY_MODE6
	RJMP	MODE_5
VERIFY_MODE6:
	CPI		R16, 0x06
	BRNE	VERIFY_MODE7
	RJMP	MODE_6
VERIFY_MODE7:
	CPI		R16, 0x07
	BRNE	MULTIPLEXAR
	RJMP	MODE_7

MULTIPLEXAR:
	RJMP	MULTIPLEXACION

MOSTRAR:
	; Cargar dígito actual
	LDS		R16, DISP_VALUE
	LDI		ZH, HIGH(table7seg<<1)
	LDI		ZL, LOW(table7seg<<1)
	ADD		ZL, R16
	LPM		R17, Z

	; A..F por PORTC
	MOV		R16, R17
	ANDI	R16, 0b00111111
	OUT		PORTC, R16

	; Construir PORTD
	LDI		R16, (1<<PD0)|(1<<PD1)

	; G en PD7
	SBRC	R17, 6
	ORI		R16, (1<<PD7)

	; DP en PD2 con PUNTO
	TST		PUNTO
	BREQ	NO_DP
	ORI		R16, (1<<PD2)
NO_DP:

	; Dígito activo
	LDS		R18, MULTIPLEXOR
	CPI		R18, 0b00001110
	BREQ	ACT_D1
	CPI		R18, 0b00001101
	BREQ	ACT_D2
	CPI		R18, 0b00001011
	BREQ	ACT_D3
	CPI		R18, 0b00000111
	BREQ	ACT_D4
	RJMP	OUT_D

ACT_D1:
	ORI		R16, (1<<PD3)
	RJMP	OUT_D
ACT_D2:
	ORI		R16, (1<<PD4)
	RJMP	OUT_D
ACT_D3:
	ORI		R16, (1<<PD5)
	RJMP	OUT_D
ACT_D4:
	ORI		R16, (1<<PD6)

OUT_D:
	OUT		PORTD, R16

	; PORTB = pullups + LEDs + buzzer
	LDI		R16, (1<<PB0)|(1<<PB3)|(1<<PB4)

	; LED hora / fecha
	LDS		R17, MODE
	CPI		R17, 0x01
	BREQ	LED_FECHA
	CPI		R17, 0x04
	BREQ	LED_FECHA
	CPI		R17, 0x05
	BREQ	LED_FECHA
	ORI		R16, (1<<PB1)
	RJMP	CHECK_ALARMA_BUZZER

LED_FECHA:
	ORI		R16, (1<<PB2)

CHECK_ALARMA_BUZZER:
	LDS		R17, ALARMA
	CPI		R17, 0x01
	BRNE	MOSTRAR_MODO
	ORI		R16, (1<<PB5)

MOSTRAR_MODO:
	OUT		PORTB, R16
	RJMP    MAIN_LOOP

;********************************************** MODOS *******************************************
;********************************************* MODO_0 *******************************************

MODE_0:
	CLI
	LDS		R16, CONTAR
	CPI		R16, 0x01
	BRNE	NO_INCREMENTO
	CLR		R16
	STS		CONTAR, R16
	SEI
	RJMP	CARGAR_VALORES
NO_INCREMENTO:
	SEI
	RJMP	EXIT_CONTAR_TIEMPO
CARGAR_VALORES:
	LDS		R17, UN_MIN
	LDS		R18, DEC_MIN
	LDS		R19, UN_HORA
	LDS		R20, DEC_HORA
	LDS		R21, UN_DIA
	LDS		R22, DEC_DIA
	LDS		R23, UN_MES
	LDS		R24, DEC_MES

	INC		R17
	CPI		R17, 10
	BREQ	SUMAR_DEC_MIN
	RJMP	GUARDAR_TMR1_ISR
SUMAR_DEC_MIN:
	CLR		R17
	INC		R18
	CPI		R18, 6
	BREQ	SUMAR_UN_HORA
	RJMP	GUARDAR_TMR1_ISR
SUMAR_UN_HORA:
	CLR		R18
	INC		R19
	CPI		R19, 4
	BREQ	VERIFY_CAMBIO_DIA
	CPI		R19, 10
	BREQ	SUMAR_DEC_HORA
	RJMP	GUARDAR_TMR1_ISR
SUMAR_DEC_HORA:
	CLR		R19
	INC		R20
VERIFY_CAMBIO_DIA:
	CPI		R19, 4
	BREQ	COMPARAR_DEC_HORA
	RJMP	GUARDAR_TMR1_ISR
COMPARAR_DEC_HORA:
	CPI		R20, 2
	BREQ	LIMPIAR_HORA
	RJMP	GUARDAR_TMR1_ISR
LIMPIAR_HORA:
	CLR		R19
	CLR		R20

	CPI		R24, 1
	BREQ	TRES_MESES_FINALES
	RJMP	NUEVE_MESES_PRIMEROS

TRES_MESES_FINALES:
	CPI		R23, 1
	BREQ	TREINTA_DIAS
	RJMP	TREINTA_Y_UN_DIAS

NUEVE_MESES_PRIMEROS:
	CPI		R23, 2
	BREQ	VEINTIOCHO_DIAS
	CPI		R23, 4
	BREQ	TREINTA_DIAS
	CPI		R23, 6
	BREQ	TREINTA_DIAS
	CPI		R23, 9
	BREQ	TREINTA_DIAS
	RJMP	TREINTA_Y_UN_DIAS

VEINTIOCHO_DIAS:
	INC		R21
	CPI		R21, 9
	BREQ	VERIFY_CAMBIO_MES3
	CPI		R21, 10
	BRNE	GUARDAR_TMR1_ISR
	CLR		R21
	INC		R22
VERIFY_CAMBIO_MES3:
	CPI		R21, 9
	BRNE	GUARDAR_TMR1_ISR
	CPI		R22, 2
	BRNE	GUARDAR_TMR1_ISR
	LDI		R21, 0x01
	CLR		R22
	RJMP	CAMBIO_MES

TREINTA_Y_UN_DIAS:
	INC		R21
	CPI		R21, 2
	BREQ	VERIFY_CAMBIO_MES2
	CPI		R21, 10
	BRNE	GUARDAR_TMR1_ISR
	CLR		R21
	INC		R22
VERIFY_CAMBIO_MES2:
	CPI		R21, 2
	BRNE	GUARDAR_TMR1_ISR
	CPI		R22, 3
	BRNE	GUARDAR_TMR1_ISR
	LDI		R21, 0x01
	CLR		R22
	RJMP	CAMBIO_MES

TREINTA_DIAS:
	INC		R21
	CPI		R21, 1
	BREQ	VERIFY_CAMBIO_MES1
	CPI		R21, 10
	BRNE	GUARDAR_TMR1_ISR
	CLR		R21
	INC		R22
VERIFY_CAMBIO_MES1:
	CPI		R21, 1
	BRNE	GUARDAR_TMR1_ISR
	CPI		R22, 3
	BRNE	GUARDAR_TMR1_ISR
	LDI		R21, 0x01
	CLR		R22
	RJMP	CAMBIO_MES

CAMBIO_MES:
	INC		R23
	CPI		R23, 3
	BREQ	VERIFY_DICIEMBRE
	CPI		R23, 10
	BRNE	GUARDAR_TMR1_ISR
	CLR		R23
	INC		R24
VERIFY_DICIEMBRE:
	CPI		R23, 3
	BRNE	GUARDAR_TMR1_ISR
	CPI		R24, 1
	BRNE	GUARDAR_TMR1_ISR
	LDI		R23, 1
	CLR		R24
	RJMP	GUARDAR_TMR1_ISR

GUARDAR_TMR1_ISR:
	STS		UN_MIN, R17
	STS		DEC_MIN, R18
	STS		UN_HORA, R19
	STS		DEC_HORA, R20
	STS		UN_DIA, R21
	STS		DEC_DIA, R22
	STS		UN_MES, R23
	STS		DEC_MES, R24

ALARMA_Y_MODO:
	LDS		R16, UN_MIN
	LDS		R17, UN_MIN_ALARMA
	LDS		R18, DEC_MIN
	LDS		R19, DEC_MIN_ALARMA
	LDS		R20, UN_HORA
	LDS		R21, UN_HORA_ALARMA
	LDS		R22, DEC_HORA
	LDS		R23, DEC_HORA_ALARMA
	CP		R16, R17
	BRNE	EXIT_CONTAR_TIEMPO
	CP		R18, R19
	BRNE	EXIT_CONTAR_TIEMPO
	CP		R20, R21
	BRNE	EXIT_CONTAR_TIEMPO
	CP		R22, R23
	BRNE	EXIT_CONTAR_TIEMPO
	LDI		R16, 0x01
	STS		ALARMA, R16

EXIT_CONTAR_TIEMPO:
	CLI
	LDS		R16, INCREMENTAR
	CPI		R16, 0x01
	BRNE	NO_BOTON1_MODE0
	CLR		R16
	STS		INCREMENTAR, R16
	SEI
	RJMP	APAGAR_ALARMA_MODE0
NO_BOTON1_MODE0:
	SEI
	CLI
	LDS		R16, DECREMENTAR
	CPI		R16, 0x01
	BRNE	NO_BOTON2_MODE0
	CLR		R16
	STS		DECREMENTAR, R16
	SEI
	RJMP	APAGAR_ALARMA_MODE0
NO_BOTON2_MODE0:
	SEI
	RJMP	EXIT_MODE_0
APAGAR_ALARMA_MODE0:
	LDI		R16, 0x00
	STS		ALARMA, R16

EXIT_MODE_0:
	RJMP	MULTIPLEXAR

MODE_1:
	RJMP	MODE_0

MODE_2:
	CLI
	LDS		R16, INCREMENTAR
	CPI		R16, 0x01
	BRNE	NO_INCREMENTAR_MIN
	CLR		R16
	STS		INCREMENTAR, R16
	SEI
	RJMP	INCREMENTAR_MIN
NO_INCREMENTAR_MIN:
	SEI
	CLI
	LDS		R16, DECREMENTAR
	CPI		R16, 0x01
	BRNE	NO_DECREMENTAR_MIN
	CLR		R16
	STS		DECREMENTAR, R16
	SEI
	RJMP	DECREMENTAR_MIN
NO_DECREMENTAR_MIN:
	SEI
	RJMP	EXIT_MODE_2
INCREMENTAR_MIN:
	LDS		R17, UN_MIN
	LDS		R18, DEC_MIN
	INC		R17
	CPI		R17, 10
	BRNE	GUARDAR_INC_MIN
	CLR		R17
	INC		R18
	CPI		R18, 6
	BRNE	GUARDAR_INC_MIN
	CLR		R18
GUARDAR_INC_MIN:
	STS		UN_MIN, R17
	STS		DEC_MIN, R18
	RJMP	EXIT_MODE_2

DECREMENTAR_MIN:
	LDS		R17, UN_MIN
	LDS		R18, DEC_MIN
	DEC		R17
	CPI		R17, 255
	BRNE	GUARDAR_DEC_MIN
	LDI		R17, 9
	DEC		R18
	CPI		R18, 255
	BRNE	GUARDAR_DEC_MIN
	LDI		R18, 5
GUARDAR_DEC_MIN:
	STS		UN_MIN, R17
	STS		DEC_MIN, R18

EXIT_MODE_2:
	RJMP	MULTIPLEXAR

MODE_3:
	CLI
	LDS		R16, INCREMENTAR
	CPI		R16, 0x01
	BRNE	NO_INCREMENTAR_HORA
	CLR		R16
	STS		INCREMENTAR, R16
	SEI
	RJMP	INCREMENTAR_HORA
NO_INCREMENTAR_HORA:
	SEI
	CLI
	LDS		R16, DECREMENTAR
	CPI		R16, 0x01
	BRNE	NO_DECREMENTAR_HORA
	CLR		R16
	STS		DECREMENTAR, R16
	SEI
	RJMP	DECREMENTAR_HORA
NO_DECREMENTAR_HORA:
	SEI
	RJMP	EXIT_MODE_3
INCREMENTAR_HORA:
	LDS		R17, UN_HORA
	LDS		R18, DEC_HORA
	INC		R17
	CPI		R17, 4
	BREQ	VERIFY_24HRS
	CPI		R17, 10
	BREQ	INCREMENTAR_DEC_HORA
	RJMP	GUARDAR_INC_HORA
INCREMENTAR_DEC_HORA:
	CLR		R17
	INC		R18
VERIFY_24HRS:
	CPI		R17, 4
	BREQ	COMPARAR_DEC_HORA_INC
	RJMP	GUARDAR_INC_HORA
COMPARAR_DEC_HORA_INC:
	CPI		R18, 2
	BREQ	LIMPIAR_HORA_INC
	RJMP	GUARDAR_INC_HORA
LIMPIAR_HORA_INC:
	CLR		R17
	CLR		R18
GUARDAR_INC_HORA:
	STS		UN_HORA, R17
	STS		DEC_HORA, R18
	RJMP	EXIT_MODE_3

DECREMENTAR_HORA:
	LDS		R17, UN_HORA
	LDS		R18, DEC_HORA
	DEC		R17
	CPI		R17, 255
	BREQ	DECREMENTAR_DEC_HORA
	RJMP	GUARDAR_DEC_HORA
DECREMENTAR_DEC_HORA:
	LDI		R17, 9
	DEC		R18
	CPI		R18, 255
	BREQ	LIMPIAR_HORA_DEC
	RJMP	GUARDAR_DEC_HORA
LIMPIAR_HORA_DEC:
	LDI		R17, 3
	LDI		R18, 2
GUARDAR_DEC_HORA:
	STS		UN_HORA, R17
	STS		DEC_HORA, R18
	RJMP	EXIT_MODE_3

EXIT_MODE_3:
	RJMP	MULTIPLEXAR

MODE_4:
	CLI
	LDS		R16, INCREMENTAR
	CPI		R16, 0x01
	BRNE	NO_INCREMENTAR_MES
	CLR		R16
	STS		INCREMENTAR, R16
	SEI
	RJMP	INCREMENTAR_MES
NO_INCREMENTAR_MES:
	SEI
	CLI
	LDS		R16, DECREMENTAR
	CPI		R16, 0x01
	BRNE	NO_DECREMENTAR_MES
	CLR		R16
	STS		DECREMENTAR, R16
	SEI
	RJMP	DECREMENTAR_MES
NO_DECREMENTAR_MES:
	SEI
	RJMP	EXIT_MODE_4
INCREMENTAR_MES:
	LDS		R17, UN_MES
	LDS		R18, DEC_MES
	INC		R17
	CPI		R17, 3
	BREQ	VERIFY_MES12
	CPI		R17, 10
	BREQ	INCREMENTAR_DEC_MES
	RJMP	GUARDAR_INC_MES
INCREMENTAR_DEC_MES:
	CLR		R17
	INC		R18
VERIFY_MES12:
	CPI		R17, 3
	BREQ	COMPARAR_DEC_MES_INC
	RJMP	GUARDAR_INC_MES
COMPARAR_DEC_MES_INC:
	CPI		R18, 1
	BREQ	LIMPIAR_MES_INC
	RJMP	GUARDAR_INC_MES
LIMPIAR_MES_INC:
	LDI		R17, 0x01
	CLR		R18
GUARDAR_INC_MES:
	STS		UN_MES, R17
	STS		DEC_MES, R18
	RJMP	EXIT_MODE_4

DECREMENTAR_MES:
	LDS		R17, UN_MES
	LDS		R18, DEC_MES
	CPI		R17, 1
	BRNE	NORMAL_DEC_CHECK
	CPI		R18, 0
	BRNE	NORMAL_DEC_CHECK
	LDI		R17, 2
	LDI		R18, 1
	RJMP	GUARDAR_DEC_MES
NORMAL_DEC_CHECK:
	DEC		R17
	CPI		R17, 255
	BRNE	GUARDAR_DEC_MES
	LDI		R17, 9
	DEC		R18
GUARDAR_DEC_MES:
	STS		UN_MES, R17
	STS		DEC_MES, R18
	RJMP	EXIT_MODE_4

EXIT_MODE_4:
	RJMP	MULTIPLEXAR

MODE_5:
	CLI
	LDS		R16, INCREMENTAR
	CPI		R16, 0x01
	BRNE	NO_INCREMENTAR_DIA
	CLR		R16
	STS		INCREMENTAR, R16
	SEI
	RJMP	INCREMENTAR_DIA
NO_INCREMENTAR_DIA:
	SEI
	CLI
	LDS		R16, DECREMENTAR
	CPI		R16, 0x01
	BRNE	NO_DECREMENTAR_DIA
	CLR		R16
	STS		DECREMENTAR, R16
	SEI
	RJMP	DECREMENTAR_DIA
NO_DECREMENTAR_DIA:
	SEI
	RJMP	EXIT_MODE_5
INCREMENTAR_DIA:
	LDS		R16, UN_DIA
	LDS		R17, DEC_DIA
	LDS		R18, UN_MES
	LDS		R19, DEC_MES
	CPI		R19, 1
	BREQ	TRES_MESES_FINALES_INC_DIA
	RJMP	NUEVE_MESES_PRIMEROS_INC_DIA

TRES_MESES_FINALES_INC_DIA:
	CPI		R18, 1
	BREQ	TREINTA_DIAS_INC_DIA
	RJMP	TREINTA_Y_UN_DIAS_INC_DIA

NUEVE_MESES_PRIMEROS_INC_DIA:
	CPI		R18, 2
	BREQ	VEINTIOCHO_DIAS_INC_DIA
	CPI		R18, 4
	BREQ	TREINTA_DIAS_INC_DIA
	CPI		R18, 6
	BREQ	TREINTA_DIAS_INC_DIA
	CPI		R18, 9
	BREQ	TREINTA_DIAS_INC_DIA
	RJMP	TREINTA_Y_UN_DIAS_INC_DIA

VEINTIOCHO_DIAS_INC_DIA:
	INC		R16
	CPI		R16, 9
	BREQ	VERIFY_CAMBIO_MES3_INC_DIA
	CPI		R16, 10
	BRNE	GUARDAR_INC_DIA
	CLR		R16
	INC		R17
VERIFY_CAMBIO_MES3_INC_DIA:
	CPI		R16, 9
	BRNE	GUARDAR_INC_DIA
	CPI		R17, 2
	BRNE	GUARDAR_INC_DIA
	LDI		R16, 0x01
	CLR		R17
	RJMP	GUARDAR_INC_DIA

TREINTA_Y_UN_DIAS_INC_DIA:
	INC		R16
	CPI		R16, 2
	BREQ	VERIFY_CAMBIO_MES2_INC_DIA
	CPI		R16, 10
	BRNE	GUARDAR_INC_DIA
	CLR		R16
	INC		R17
VERIFY_CAMBIO_MES2_INC_DIA:
	CPI		R16, 2
	BRNE	GUARDAR_INC_DIA
	CPI		R17, 3
	BRNE	GUARDAR_INC_DIA
	LDI		R16, 0x01
	CLR		R17
	RJMP	GUARDAR_INC_DIA

TREINTA_DIAS_INC_DIA:
	INC		R16
	CPI		R16, 1
	BREQ	VERIFY_CAMBIO_MES1_INC_DIA
	CPI		R16, 10
	BRNE	GUARDAR_INC_DIA
	CLR		R16
	INC		R17
VERIFY_CAMBIO_MES1_INC_DIA:
	CPI		R16, 1
	BRNE	GUARDAR_INC_DIA
	CPI		R17, 3
	BRNE	GUARDAR_INC_DIA
	LDI		R16, 0x01
	CLR		R17
	RJMP	GUARDAR_INC_DIA

GUARDAR_INC_DIA:
	STS		UN_DIA, R16
	STS		DEC_DIA, R17
	STS		UN_MES, R18
	STS		DEC_MES, R19
	RJMP EXIT_MODE_5

DECREMENTAR_DIA:
	LDS     R16, UN_DIA
	LDS     R17, DEC_DIA
	LDS     R18, UN_MES
	LDS     R19, DEC_MES
	CPI     R16, 1
	BRNE    NORMAL_DEC_DIA
	CPI     R17, 0
	BRNE    NORMAL_DEC_DIA
	CPI     R19, 1
	BREQ    TRES_MESES_FINALES_DEC_DIA
	RJMP    NUEVE_MESES_PRIMEROS_DEC_DIA
TRES_MESES_FINALES_DEC_DIA:
	CPI     R18, 1
	BREQ    CARGAR_30
	RJMP    CARGAR_31
NUEVE_MESES_PRIMEROS_DEC_DIA:
	CPI     R18, 2
	BREQ    CARGAR_28
	CPI     R18, 4
	BREQ    CARGAR_30
	CPI     R18, 6
	BREQ    CARGAR_30
	CPI     R18, 9
	BREQ    CARGAR_30
	RJMP    CARGAR_31
CARGAR_28:
	LDI     R16, 8
	LDI     R17, 2
	RJMP    GUARDAR_DEC_DIA
CARGAR_30:
	LDI     R16, 0
	LDI     R17, 3
	RJMP    GUARDAR_DEC_DIA
CARGAR_31:
	LDI     R16, 1
	LDI     R17, 3
	RJMP    GUARDAR_DEC_DIA
NORMAL_DEC_DIA:
	DEC     R16
	CPI     R16, 255
	BRNE    GUARDAR_DEC_DIA
	LDI     R16, 9
	DEC     R17
GUARDAR_DEC_DIA:
	STS     UN_DIA, R16
	STS     DEC_DIA, R17
	STS     UN_MES, R18
	STS     DEC_MES, R19
	RJMP    EXIT_MODE_5

EXIT_MODE_5:
	RJMP	MULTIPLEXAR

MODE_6:
	CLI
	LDS		R16, INCREMENTAR
	CPI		R16, 0x01
	BRNE	NO_INCREMENTAR_MIN_ALARMA
	CLR		R16
	STS		INCREMENTAR, R16
	SEI
	RJMP	INCREMENTAR_MIN_ALARMA
NO_INCREMENTAR_MIN_ALARMA:
	SEI
	CLI
	LDS		R16, DECREMENTAR
	CPI		R16, 0x01
	BRNE	NO_DECREMENTAR_MIN_ALARMA
	CLR		R16
	STS		DECREMENTAR, R16
	SEI
	RJMP	DECREMENTAR_MIN_ALARMA
NO_DECREMENTAR_MIN_ALARMA:
	SEI
	RJMP	EXIT_MODE_6
INCREMENTAR_MIN_ALARMA:
	LDS		R17, UN_MIN_ALARMA
	LDS		R18, DEC_MIN_ALARMA
	INC		R17
	CPI		R17, 10
	BRNE	GUARDAR_INC_MIN_ALARMA
	CLR		R17
	INC		R18
	CPI		R18, 6
	BRNE	GUARDAR_INC_MIN_ALARMA
	CLR		R18
GUARDAR_INC_MIN_ALARMA:
	STS		UN_MIN_ALARMA, R17
	STS		DEC_MIN_ALARMA, R18
	RJMP	EXIT_MODE_6

DECREMENTAR_MIN_ALARMA:
	LDS		R17, UN_MIN_ALARMA
	LDS		R18, DEC_MIN_ALARMA
	DEC		R17
	CPI		R17, 255
	BRNE	GUARDAR_DEC_MIN_ALARMA
	LDI		R17, 9
	DEC		R18
	CPI		R18, 255
	BRNE	GUARDAR_DEC_MIN_ALARMA
	LDI		R18, 5
GUARDAR_DEC_MIN_ALARMA:
	STS		UN_MIN_ALARMA, R17
	STS		DEC_MIN_ALARMA, R18

EXIT_MODE_6:
	RJMP	MULTIPLEXAR

MODE_7:
	CLI
	LDS		R16, INCREMENTAR
	CPI		R16, 0x01
	BRNE	NO_INCREMENTAR_HORA_ALARMA
	CLR		R16
	STS		INCREMENTAR, R16
	SEI
	RJMP	INCREMENTAR_HORA_ALARMA
NO_INCREMENTAR_HORA_ALARMA:
	SEI
	CLI
	LDS		R16, DECREMENTAR
	CPI		R16, 0x01
	BRNE	NO_DECREMENTAR_HORA_ALARMA
	CLR		R16
	STS		DECREMENTAR, R16
	SEI
	RJMP	DECREMENTAR_HORA_ALARMA
NO_DECREMENTAR_HORA_ALARMA:
	SEI
	RJMP	EXIT_MODE_7
INCREMENTAR_HORA_ALARMA:
	LDS		R17, UN_HORA_ALARMA
	LDS		R18, DEC_HORA_ALARMA
	INC		R17
	CPI		R17, 4
	BREQ	VERIFY_24HRS_ALARMA
	CPI		R17, 10
	BREQ	INCREMENTAR_DEC_HORA_ALARMA
	RJMP	GUARDAR_INC_HORA_ALARMA
INCREMENTAR_DEC_HORA_ALARMA:
	CLR		R17
	INC		R18
VERIFY_24HRS_ALARMA:
	CPI		R17, 4
	BREQ	COMPARAR_DEC_HORA_INC_ALARMA
	RJMP	GUARDAR_INC_HORA_ALARMA
COMPARAR_DEC_HORA_INC_ALARMA:
	CPI		R18, 2
	BREQ	LIMPIAR_HORA_INC_ALARMA
	RJMP	GUARDAR_INC_HORA_ALARMA
LIMPIAR_HORA_INC_ALARMA:
	CLR		R17
	CLR		R18
GUARDAR_INC_HORA_ALARMA:
	STS		UN_HORA_ALARMA, R17
	STS		DEC_HORA_ALARMA, R18
	RJMP	EXIT_MODE_7

DECREMENTAR_HORA_ALARMA:
	LDS		R17, UN_HORA_ALARMA
	LDS		R18, DEC_HORA_ALARMA
	DEC		R17
	CPI		R17, 255
	BREQ	DECREMENTAR_DEC_HORA_ALARMA
	RJMP	GUARDAR_DEC_HORA_ALARMA
DECREMENTAR_DEC_HORA_ALARMA:
	LDI		R17, 9
	DEC		R18
	CPI		R18, 255
	BREQ	LIMPIAR_HORA_DEC_ALARMA
	RJMP	GUARDAR_DEC_HORA_ALARMA
LIMPIAR_HORA_DEC_ALARMA:
	LDI		R17, 3
	LDI		R18, 2
GUARDAR_DEC_HORA_ALARMA:
	STS		UN_HORA_ALARMA, R17
	STS		DEC_HORA_ALARMA, R18
	RJMP	EXIT_MODE_7

EXIT_MODE_7:
	RJMP	MULTIPLEXAR

MULTIPLEXACION:
	CLI
	LDS		R16, MULTIPLEXION
	CPI		R16, 0x01
	BRNE	NO_MULTIPLEXAR
	CLR		R16
	STS		MULTIPLEXION, R16
	SEI
	RJMP	MULTIPLEXAR_VALORES
NO_MULTIPLEXAR:
	SEI
	RJMP	EXIT_MULTIPLEXACION
MULTIPLEXAR_VALORES:

MULTIPLEXAR_MODE0:
	LDS		R16, MODE
	CPI		R16, 0x00
	BRNE	MULTIPLEXAR_MODE1
	RJMP	VALORES_MODE_0
MULTIPLEXAR_MODE1:
	CPI		R16, 0x01
	BRNE	MULTIPLEXAR_MODE2
	RJMP	VALORES_MODE_1
MULTIPLEXAR_MODE2:
	CPI		R16, 0x02
	BRNE	MULTIPLEXAR_MODE3
	RJMP	VALORES_MODE_2
MULTIPLEXAR_MODE3:
	CPI		R16, 0x03
	BRNE	MULTIPLEXAR_MODE4
	RJMP	VALORES_MODE_3
MULTIPLEXAR_MODE4:
	CPI		R16, 0x04
	BRNE	MULTIPLEXAR_MODE5
	RJMP	VALORES_MODE_4
MULTIPLEXAR_MODE5:
	CPI		R16, 0x05
	BRNE	MULTIPLEXAR_MODE6
	RJMP	VALORES_MODE_5
MULTIPLEXAR_MODE6:
	CPI		R16, 0x06
	BRNE	MULTIPLEXAR_MODE7
	RJMP	VALORES_MODE_6
MULTIPLEXAR_MODE7:
	CPI		R16, 0x07
	BRNE	SALIDA
	RJMP	VALORES_MODE_7
SALIDA:
	RJMP	EXIT_MULTIPLEXACION

VALORES_MODE_0:
	RJMP MOSTRAR_HORA
VALORES_MODE_1:
	RJMP MOSTRAR_DIA
VALORES_MODE_2:
	RJMP MOSTRAR_HORA
VALORES_MODE_3:
	RJMP MOSTRAR_HORA
VALORES_MODE_4:
	RJMP MOSTRAR_DIA
VALORES_MODE_5:
	RJMP MOSTRAR_DIA
VALORES_MODE_6:
	RJMP MOSTRAR_HORA_ALARMA
VALORES_MODE_7:
	RJMP MOSTRAR_HORA_ALARMA

MOSTRAR_HORA:
	LDS		R16, MULTIPLEXOR
	CPI		R16, 0b00001110
	BREQ	CAMBIO_C1_HORA
	CPI		R16, 0b00001101
	BREQ	CAMBIO_C2_HORA
	CPI		R16, 0b00001011
	BREQ	CAMBIO_C3_HORA
	CPI		R16, 0b00000111
	BREQ	CAMBIO_C0_HORA
CAMBIO_C0_HORA:
	LDI		R16, 0b00001110
	LDS		R17, UN_MIN
	RJMP GUARDAR_VALORES_HORA
CAMBIO_C1_HORA:
	LDI		R16, 0b00001101
	LDS		R17, DEC_MIN
	RJMP GUARDAR_VALORES_HORA
CAMBIO_C2_HORA:
	LDI		R16, 0b00001011
	LDS		R17, UN_HORA
	RJMP GUARDAR_VALORES_HORA
CAMBIO_C3_HORA:
	LDI		R16, 0b00000111
	LDS		R17, DEC_HORA
	RJMP GUARDAR_VALORES_HORA
GUARDAR_VALORES_HORA:
	STS		MULTIPLEXOR, R16
	STS		DISP_VALUE, R17
	RJMP EXIT_MULTIPLEXACION

MOSTRAR_DIA:
	LDS		R16, MULTIPLEXOR
	CPI		R16, 0b00001110
	BREQ	CAMBIO_C1_DIA
	CPI		R16, 0b00001101
	BREQ	CAMBIO_C2_DIA
	CPI		R16, 0b00001011
	BREQ	CAMBIO_C3_DIA
	CPI		R16, 0b00000111
	BREQ	CAMBIO_C0_DIA
CAMBIO_C0_DIA:
	LDI		R16, 0b00001110
	LDS		R17, UN_MES
	RJMP GUARDAR_VALORES_DIA
CAMBIO_C1_DIA:
	LDI		R16, 0b00001101
	LDS		R17, DEC_MES
	RJMP GUARDAR_VALORES_DIA
CAMBIO_C2_DIA:
	LDI		R16, 0b00001011
	LDS		R17, UN_DIA
	RJMP GUARDAR_VALORES_DIA
CAMBIO_C3_DIA:
	LDI		R16, 0b00000111
	LDS		R17, DEC_DIA
	RJMP GUARDAR_VALORES_DIA
GUARDAR_VALORES_DIA:
	STS		MULTIPLEXOR, R16
	STS		DISP_VALUE, R17
	RJMP EXIT_MULTIPLEXACION

MOSTRAR_HORA_ALARMA:
	LDS		R16, MULTIPLEXOR
	CPI		R16, 0b00001110
	BREQ	CAMBIO_C1_HORA_ALARMA
	CPI		R16, 0b00001101
	BREQ	CAMBIO_C2_HORA_ALARMA
	CPI		R16, 0b00001011
	BREQ	CAMBIO_C3_HORA_ALARMA
	CPI		R16, 0b00000111
	BREQ	CAMBIO_C0_HORA_ALARMA
CAMBIO_C0_HORA_ALARMA:
	LDI		R16, 0b00001110
	LDS		R17, UN_MIN_ALARMA
	RJMP GUARDAR_VALORES_HORA_ALARMA
CAMBIO_C1_HORA_ALARMA:
	LDI		R16, 0b00001101
	LDS		R17, DEC_MIN_ALARMA
	RJMP GUARDAR_VALORES_HORA_ALARMA
CAMBIO_C2_HORA_ALARMA:
	LDI		R16, 0b00001011
	LDS		R17, UN_HORA_ALARMA
	RJMP GUARDAR_VALORES_HORA_ALARMA
CAMBIO_C3_HORA_ALARMA:
	LDI		R16, 0b00000111
	LDS		R17, DEC_HORA_ALARMA
	RJMP GUARDAR_VALORES_HORA_ALARMA
GUARDAR_VALORES_HORA_ALARMA:
	STS		MULTIPLEXOR, R16
	STS		DISP_VALUE, R17
	RJMP EXIT_MULTIPLEXACION

EXIT_MULTIPLEXACION:
	RJMP	MOSTRAR

INIT_TMR1:
	CLR		R16
	STS		TCCR1A, R16
	LDI		R16, (1 << CS12)
	STS		TCCR1B, R16
	LDI		R16, HIGH(TMR1_VALUE)
	STS		TCNT1H, R16
	LDI		R16, LOW(TMR1_VALUE)
	STS		TCNT1L, R16
	RET

INIT_TMR0:
	CLR		R16
	OUT		TCCR0A, R16
	LDI		R16, (1 << CS02)
	OUT		TCCR0B , R16
	LDI		R16, TMR0_VALUE
	OUT		TCNT0, R16
	RET

DELAY_BOTON:
	LDI		R18, 8
DB1:
	LDI		R19, 255
DB2:
	DEC		R19
	BRNE	DB2
	DEC		R18
	BRNE	DB1
	RET

PINB_ISR:
	PUSH	R16
	IN		R16, SREG
	PUSH	R16
	PUSH	R17

	RCALL	DELAY_BOTON
	IN		R16, PINB

	; MODO en PB0
	SBRS	R16, PB0
	RJMP	AUMENTAR_MODE

	; HORA + en PB3
	SBRS	R16, PB3
	RJMP	SET_INCREMENTAR

	; HORA - en PB4
	SBRS	R16, PB4
	RJMP	SET_DECREMENTAR

	RJMP	EXIT_PINB_ISR

AUMENTAR_MODE:
	LDS		R17, MODE
	INC		R17
	CPI		R17, 8
	BRLO	GUARDAR_MODE
	CLR		R17
GUARDAR_MODE:
	STS		MODE, R17
	RJMP	EXIT_PINB_ISR

SET_INCREMENTAR:
	LDI		R17, 0x01
	STS		INCREMENTAR, R17
	RJMP	EXIT_PINB_ISR

SET_DECREMENTAR:
	LDI		R17, 0x01
	STS		DECREMENTAR, R17

EXIT_PINB_ISR:
	POP		R17
	POP		R16
	OUT		SREG, R16
	POP		R16
	RETI

PIND_ISR:
	PUSH	R16
	IN		R16, SREG
	PUSH	R16
	PUSH	R17

	RCALL	DELAY_BOTON
	IN		R16, PIND

	; FECHA + en PD0
	SBRS	R16, PD0
	RJMP	SET_INCREMENTAR_D

	; FECHA - en PD1
	SBRS	R16, PD1
	RJMP	SET_DECREMENTAR_D

	RJMP	EXIT_PIND_ISR

SET_INCREMENTAR_D:
	LDI		R17, 0x01
	STS		INCREMENTAR, R17
	RJMP	EXIT_PIND_ISR

SET_DECREMENTAR_D:
	LDI		R17, 0x01
	STS		DECREMENTAR, R17

EXIT_PIND_ISR:
	POP		R17
	POP		R16
	OUT		SREG, R16
	POP		R16
	RETI

TMR0_ISR:
	PUSH	R16
	IN		R16, SREG
	PUSH	R16
	PUSH	R17
	LDI		R16, TMR0_VALUE
	OUT		TCNT0, R16
	LDI		R16, 0x01
	STS		MULTIPLEXION, R16
EXIT_TMR0_ISR:
	POP		R17
	POP		R16
	OUT		SREG, R16
	POP		R16
	RETI

TMR1_ISR:
	PUSH	R16
	IN		R16, SREG
	PUSH	R16
	PUSH	R17
	LDI		R16, HIGH(TMR1_VALUE)
	STS		TCNT1H, R16
	LDI		R16, LOW(TMR1_VALUE)
	STS		TCNT1L, R16
	LDI		R16, 0b10000000
	EOR		PUNTO, R16
	LDS		R16, TIEMPO
	INC		R16
	CPI		R16, 120
	BRNE	EXIT_TMR1_ISR
	LDI		R16, 0x01
	STS		CONTAR, R16
	CLR		R16
EXIT_TMR1_ISR:
	STS		TIEMPO, R16
	POP		R17
	POP		R16
	OUT		SREG, R16
	POP		R16
	RETI
